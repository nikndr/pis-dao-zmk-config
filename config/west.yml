## config/west.yml
```yaml
manifest:
  remotes:
    - name: zmkfirmware
      url-base: https://github.com/zmkfirmware
    - name: ergonautkb
      url-base: https://github.com/ergonautkb
    - name: urob
      url-base: https://github.com/urob
    - name: nikndr
      url-base: https://github.com/nikndr
  projects:
    - name: zmk
      remote: zmkfirmware
      revision: main
      import: app/west.yml
    - name: ergonautkb-zmk-module
      remote: ergonautkb
      revision: main
    - name: zmk-helpers
      remote: urob
      revision: main
    - name: zmk-tri-state
      remote: nikndr
      revision: main
  self:
    path: config
```
